## conf/layer.conf
```bitbake
# We have a conf and classes directory, add to BBPATH
BBPATH .= ":${LAYERDIR}"

# We have recipes-* directories, add to BBFILES
BBFILES += "${LAYERDIR}/recipes-*/*/*.bb \
            ${LAYERDIR}/recipes-*/*/*.bbappend"

BBFILE_COLLECTIONS += "meta-custom-bt"
BBFILE_PATTERN_meta-custom-bt = "^${LAYERDIR}/"
BBFILE_PRIORITY_meta-custom-bt = "6"

LAYERDEPENDS_meta-custom-bt = "core"
LAYERSERIES_COMPAT_meta-custom-bt = "mickledore scarthgap"
```
